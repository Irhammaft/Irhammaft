## drivers/oneplus/Kconfig
```kconfig
source "drivers/oneplus/hung_task_enhance/Kconfig"
source "drivers/oneplus/coretech/Kconfig"
```

## drivers/oneplus/coretech/Kconfig
```kconfig
config OPCHAIN
	default n
	bool "Oneplus CoreTech helper, used for opchain module"
config MEMPLUS
	default n
	bool "memory+ feature"
	help
	 Memory+ feature
config SMART_BOOST
	bool "support smart boost feature"
	default y
	help
	 this feature allow memory used by recent-app stay in kernel.
config DEFRAG
	default n
	bool "anti-defragment feature"
	help
	 anti-defragment feature.
config FSC
	default n
	bool "system layer file status cache"
	help
	 To cache absence file and avoid stat call storm
config HOUSTON
	default y
	bool "to collect system-wide and pmu data"
	help
	 Realtime temperature monitor
config CONTROL_CENTER
	default y
	bool "control center"
	help
	 A framework to adjust system resource such as perfd, but easy to extend
	 the scope of use. Support priority control between different request and
	 QoS for keep adjusting for a specific period. Besides resource controlling,
	 it also provide a decision model for helping governor to make decision.

config AIGOV
	default y
	bool "A governor which using ai predicted info as input"

config IM
	bool "identify task itself"
	default n
	help
	  In many cases we need to identify task, all we do is simply string compare,
	  but in some performance sensitive context like scheduler, it's not a good choice to
	  do that. So this IM thing can let we check task only through one comparsion.

config PCCORE
	default y
	bool "pccore feature"

config VM_FRAGMENT_MONITOR
	default y
	bool "monitor virtual memory fragment"

config UXCHAIN
	default y
	bool "A sched policy for ux relative threads "

config RATP
       bool "restricted admission for task placement in low-end platfom"
       default n
       help
         In low-end platform, we will restrict admission for task placement to avoid
         CPU resource contention.
		 
config MEMEX_STANDALONE
	default n
	bool "MemEX feature"
	help
	 MemEX feature
	 
config CRPL_HELPER
	default y
	bool "Oneplus CoreTech helper, used for crpl module"
	 
config ADJ_CHAIN
	default y
	bool "Chain task adj for victim select"
	help
	 To chain task adj for any purpose

config CPUFREQ_BOUNCING
	default y
	bool "A power optimization feature to control excessive heating of devices"

config TPD
	default n
	bool "a task placement decision for cpu limitation"
	help
	 Task affinity by decison
```

## drivers/oneplus/hung_task_enhance/Kconfig
```kconfig
config HUNG_TASK_ENHANCE
	bool "hung task enhance"
	default y
	depends on DETECT_HUNG_TASK
	help
      define this config to enable HUNG_TASK_ENHANCE .
```

## drivers/oneplus/opslalib/Kconfig
```kconfig
config SLA
	default y
	bool "to monitor netlink traffic"
	help
	  Realtime netlink traffic monitor.

config SLA_ALGO
	default y
	bool "OnePlus SLA algorithm"
```
